## Documentation/devicetree/bindings/display/panel/xiaomi,l12-36-02-0b.yaml
```yaml
# SPDX-License-Identifier: (GPL-2.0-only OR BSD-2-Clause)
%YAML 1.2
---
$id: http://devicetree.org/schemas/display/panel/xiaomi,l12-36-02-0b.yaml#
$schema: http://devicetree.org/meta-schemas/core.yaml#

title: Xiaomi 12T Pro "36 02 0b" 1220x2712 DSC command mode AMOLED panel

maintainers:
  - Local Diting bring-up <ubuntu-diting@localhost>

allOf:
  - $ref: panel-common.yaml#

properties:
  compatible:
    const: xiaomi,l12-36-02-0b

  reg:
    maxItems: 1

  vddio-supply:
    description: 1.8 V I/O supply

  vddd-supply:
    description: 1.2 V digital core supply

  vci-supply:
    description: 3.0 V analog supply

required:
  - compatible
  - reg
  - reset-gpios
  - vddio-supply
  - vddd-supply
  - vci-supply
  - port

unevaluatedProperties: false

examples:
  - |
    #include <dt-bindings/gpio/gpio.h>

    dsi {
        #address-cells = <1>;
        #size-cells = <0>;

        panel@0 {
            compatible = "xiaomi,l12-36-02-0b";
            reg = <0>;
            reset-gpios = <&tlmm 0 GPIO_ACTIVE_LOW>;
            vddio-supply = <&vreg_l12c_1p8>;
            vddd-supply = <&panel_vddd>;
            vci-supply = <&vreg_l13c_3p0>;

            port {
                panel_in: endpoint {
                    remote-endpoint = <&mdss_dsi0_out>;
                };
            };
        };
    };
```

## Documentation/devicetree/bindings/input/touchscreen/st,ftm5-spi.yaml
```yaml
# SPDX-License-Identifier: (GPL-2.0-only OR BSD-2-Clause)
%YAML 1.2
---
$id: http://devicetree.org/schemas/input/touchscreen/st,ftm5-spi.yaml#
$schema: http://devicetree.org/meta-schemas/core.yaml#

title: STMicroelectronics FTM5 FingerTip touchscreen controller (SPI)

maintainers:
  - Local Diting bring-up <ubuntu-diting@localhost>

allOf:
  - $ref: touchscreen.yaml#
  - $ref: /schemas/spi/spi-peripheral-props.yaml#

properties:
  compatible:
    const: st,ftm5-spi

  reg:
    maxItems: 1

  interrupts:
    maxItems: 1

  reset-gpios:
    maxItems: 1

  vdd-supply:
    description: Digital I/O supply

  avdd-supply:
    description: Analog supply

  spi-max-frequency:
    maximum: 12000000

required:
  - compatible
  - reg
  - interrupts
  - reset-gpios
  - vdd-supply
  - avdd-supply
  - touchscreen-size-x
  - touchscreen-size-y

unevaluatedProperties: false

examples:
  - |
    #include <dt-bindings/gpio/gpio.h>
    #include <dt-bindings/interrupt-controller/irq.h>

    spi {
        #address-cells = <1>;
        #size-cells = <0>;

        touchscreen@0 {
            compatible = "st,ftm5-spi";
            reg = <0>;
            spi-max-frequency = <12000000>;
            interrupts-extended = <&tlmm 21 IRQ_TYPE_LEVEL_LOW>;
            reset-gpios = <&tlmm 20 GPIO_ACTIVE_LOW>;
            vdd-supply = <&vreg_l2c_1p8>;
            avdd-supply = <&ts_avdd>;
            touchscreen-size-x = <12200>;
            touchscreen-size-y = <27120>;
        };
    };
```

## Documentation/devicetree/bindings/media/i2c/samsung,s5k4h7.yaml
```yaml
# SPDX-License-Identifier: (GPL-2.0-only OR BSD-2-Clause)
%YAML 1.2
---
$id: http://devicetree.org/schemas/media/i2c/samsung,s5k4h7.yaml#
$schema: http://devicetree.org/meta-schemas/core.yaml#

title: Samsung S5K4H7 Image Sensor

description:
  Samsung S5K4H7 image sensor is an 8MP image sensor. The sensor is
  controlled over a serial camera control bus protocol, the widest
  supported output image frame size is 3264x2448 at 30 frames per second,
  data output format is RAW10 transferred over 4-lane MIPI D-PHY
  interface. The module specific register settings are loaded as firmware.

maintainers:
  - Roy Kaandorp <397414+royka1@users.noreply.github.com>

allOf:
  - $ref: /schemas/media/video-interface-devices.yaml#

properties:
  compatible:
    const: samsung,s5k4h7

  reg:
    maxItems: 1

  clocks:
    description: MCLK supply clock.
    maxItems: 1

  reset-gpios:
    description: Active low GPIO connected to RESET pad of the sensor.
    maxItems: 1

  vdda-supply:
    description: Analogue voltage supply, 2.8 volts.

  vddd-supply:
    description: Digital core voltage supply, 1.05 volts.

  vddio-supply:
    description: Digital I/O voltage supply, 1.8 volts.

  firmware-name:
    maxItems: 1
    description: Register table firmware of the camera module.

  port:
    $ref: /schemas/graph.yaml#/$defs/port-base
    additionalProperties: false

    properties:
      endpoint:
        $ref: /schemas/media/video-interfaces.yaml#
        unevaluatedProperties: false

        properties:
          data-lanes:
            items:
              - const: 1
              - const: 2
              - const: 3
              - const: 4

        required:
          - link-frequencies

required:
  - compatible
  - reg
  - port

unevaluatedProperties: false

examples:
  - |
      #include <dt-bindings/gpio/gpio.h>

      i2c {
          #address-cells = <1>;
          #size-cells = <0>;

          camera@2d {
              compatible = "samsung,s5k4h7";
              reg = <0x2d>;
              clocks = <&camera_mclk 0>;
              assigned-clocks = <&camera_mclk 0>;
              assigned-clock-rates = <24000000>;
              reset-gpios = <&gpio1 10 GPIO_ACTIVE_LOW>;
              vdda-supply = <&vreg_2p8>;
              vddd-supply = <&vreg_1p05>;
              vddio-supply = <&vreg_1p8>;
              firmware-name = "s5k4h7.camregs";

              port {
                  endpoint {
                      link-frequencies = /bits/ 64 <330000000>;
                      remote-endpoint = <&mipi_csi2_ep>;
                  };
              };
          };
      };
...
```

## Documentation/devicetree/bindings/media/i2c/samsung,s5khp1.yaml
```yaml
# SPDX-License-Identifier: (GPL-2.0-only OR BSD-2-Clause)
%YAML 1.2
---
$id: http://devicetree.org/schemas/media/i2c/samsung,s5khp1.yaml#
$schema: http://devicetree.org/meta-schemas/core.yaml#

title: Samsung S5KHP1 Image Sensor

description:
  Samsung S5KHP1 (ISOCELL HP1) image sensor is a 200MP image sensor. The
  sensor is controlled over a serial camera control bus protocol, the
  widest supported output image frame size is 16384x12288, data output
  format is RAW10 transferred over a 3-trio MIPI C-PHY interface. The module
  specific register settings are loaded as firmware.

maintainers:
  - Roy Kaandorp <397414+royka1@users.noreply.github.com>

allOf:
  - $ref: /schemas/media/video-interface-devices.yaml#

properties:
  compatible:
    const: samsung,s5khp1

  reg:
    maxItems: 1

  clocks:
    description: MCLK supply clock.
    maxItems: 1

  reset-gpios:
    description: Active low GPIO connected to RESET pad of the sensor.
    maxItems: 1

  vdda-supply:
    description: Analogue voltage supply, 2.9 volts.

  vdda2-supply:
    description: Second analogue voltage supply of the module.

  vddd-supply:
    description: Digital core voltage supply, 1.1 volts.

  vddio-supply:
    description: Digital I/O voltage supply, 1.8 volts.

  firmware-name:
    maxItems: 1
    description: Register table firmware of the camera module.

  port:
    $ref: /schemas/graph.yaml#/$defs/port-base
    additionalProperties: false

    properties:
      endpoint:
        $ref: /schemas/media/video-interfaces.yaml#
        unevaluatedProperties: false

        properties:
          bus-type:
            const: 1

          data-lanes:
            items:
              - const: 1
              - const: 2
              - const: 3

        required:
          - bus-type
          - link-frequencies

required:
  - compatible
  - reg
  - port

unevaluatedProperties: false

examples:
  - |
      #include <dt-bindings/gpio/gpio.h>

      i2c {
          #address-cells = <1>;
          #size-cells = <0>;

          camera@10 {
              compatible = "samsung,s5khp1";
              reg = <0x10>;
              clocks = <&camera_mclk 0>;
              assigned-clocks = <&camera_mclk 0>;
              assigned-clock-rates = <19200000>;
              reset-gpios = <&gpio1 10 GPIO_ACTIVE_LOW>;
              vdda-supply = <&vreg_2p9>;
              vdda2-supply = <&vreg_3p1>;
              vddd-supply = <&vreg_1p1>;
              vddio-supply = <&vreg_1p8>;
              firmware-name = "s5khp1.camregs";

              port {
                  endpoint {
                      bus-type = <1>;
                      data-lanes = <1 2 3>;
                      link-frequencies = /bits/ 64 <848526000>;
                      remote-endpoint = <&mipi_csi2_ep>;
                  };
              };
          };
      };
...
```

## Documentation/devicetree/bindings/regulator/willsemi,wl2866d.yaml
```yaml
# SPDX-License-Identifier: (GPL-2.0-only OR BSD-2-Clause)
%YAML 1.2
---
$id: http://devicetree.org/schemas/regulator/willsemi,wl2866d.yaml#
$schema: http://devicetree.org/meta-schemas/core.yaml#

title: Willsemi WL2866D camera LDO

maintainers:
  - Roy Kaandorp <397414+royka1@users.noreply.github.com>

description:
  The WL2866D is an I2C controlled power management IC for camera modules
  with two DVDD LDOs (0.6 V to 1.8 V, supplied from VIN1) and two AVDD LDOs
  (1.2 V to 4.3 V, supplied from VIN2).

properties:
  compatible:
    const: willsemi,wl2866d

  reg:
    maxItems: 1

  enable-gpios:
    maxItems: 1
    description: GPIO connected to the EN pin of the chip.

  vin1-supply:
    description: Input supply of the DVDD LDOs.

  vin2-supply:
    description: Input supply of the AVDD LDOs and bias supply.

  regulators:
    type: object
    additionalProperties: false

    patternProperties:
      "^(dvdd|avdd)[12]$":
        type: object
        $ref: regulator.yaml#
        unevaluatedProperties: false

required:
  - compatible
  - reg
  - regulators

additionalProperties: false

examples:
  - |
    #include <dt-bindings/gpio/gpio.h>

    i2c {
        #address-cells = <1>;
        #size-cells = <0>;

        pmic@28 {
            compatible = "willsemi,wl2866d";
            reg = <0x28>;
            enable-gpios = <&tlmm 44 GPIO_ACTIVE_HIGH>;
            vin1-supply = <&vreg_1p25>;
            vin2-supply = <&vreg_bob>;

            regulators {
                dvdd2 {
                    regulator-name = "cam_dvdd2";
                    regulator-min-microvolt = <1200000>;
                    regulator-max-microvolt = <1200000>;
                };

                avdd1 {
                    regulator-name = "cam_avdd1";
                    regulator-min-microvolt = <1800000>;
                    regulator-max-microvolt = <1800000>;
                };
            };
        };
    };
...
```
